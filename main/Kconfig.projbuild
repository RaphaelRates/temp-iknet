## main/Kconfig.projbuild
```kconfig
menu "IKNET - Sensor de temperatura"
    config IKNET_SENSOR_GPIO
        int "GPIO de dados do DS18B20 (DQ)"
        range 0 48
        default 38
        help
            Ligue DQ ao GPIO38 e instale pull-up de 4,7 kohms entre DQ e 3V3.
endmenu
```

## sdkconfig.defaults
```kconfig
CONFIG_IDF_TARGET="esp32s3"
CONFIG_IKNET_SENSOR_GPIO=38
CONFIG_LOG_DEFAULT_LEVEL_INFO=y
```
